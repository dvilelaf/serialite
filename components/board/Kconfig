## components/board/Kconfig
```kconfig
menu "Serialite board"

choice SERIALITE_BOARD
    prompt "Target board"
    default SERIALITE_BOARD_WAVESHARE_AMOLED_1_8
    help
        Selects the board implementation behind board.h. Add a new board by
        writing one source file under components/board/src and a choice here.

config SERIALITE_BOARD_WAVESHARE_AMOLED_1_8
    bool "Waveshare ESP32-S3-Touch-AMOLED-1.8"
    select SERIALITE_BOARD_HAS_DISPLAY

config SERIALITE_BOARD_GENERIC_HEADLESS
    bool "Generic ESP32-S3 devkit without display"
    help
        One button and no display. Without a display, generated credentials
        cannot be shown, so the AP only starts with credentials stored in
        encrypted NVS.

endchoice

config SERIALITE_BOARD_HAS_DISPLAY
    bool

config SERIALITE_BOARD_PRIMARY_BUTTON_GPIO
    int "Primary button GPIO (active low)"
    depends on SERIALITE_BOARD_GENERIC_HEADLESS
    range 0 48
    default 0

endmenu
```

## main/Kconfig.projbuild
```kconfig
menu "Serialite"

config SERIALITE_AP_SSID
    string "Access point SSID"
    default "Serialite"
    help
        SSID used when no configuration is stored. A stored configuration
        (encrypted NVS only) can override it.

config SERIALITE_AP_CHANNEL
    int "Access point channel"
    range 1 13
    default 6

config SERIALITE_HOSTNAME
    string "mDNS host name"
    default "serialite"
    help
        Clients can reach the console at <name>.local. The web server only
        answers to this name and to the AP address.

config SERIALITE_HTTPS
    bool "Serve the console over HTTPS"
    default n
    help
        Generates a self-signed certificate on every boot. Its SHA-256
        fingerprint appears on the device screen (press BOOT twice) so the
        operator can compare it with the browser. Without a display, HTTPS
        falls back to HTTP because the fingerprint could not be checked.
        Production builds must enable this.

config SERIALITE_UART_SHOW_PASSWORD
    bool "Print generated WiFi passwords on the debug UART"
    depends on !SERIALITE_BOARD_HAS_DISPLAY
    default n
    help
        For boards without a display. The password is written to the UART0
        log, which needs physical access to read. Never enable this on a
        board whose UART0 is wired to the monitored server.

endmenu
```

## tools/esp_http_harness/sdkconfig.defaults
```kconfig
CONFIG_IDF_TARGET="linux"
CONFIG_HTTPD_WS_SUPPORT=y
CONFIG_HTTPD_MAX_REQ_HDR_LEN=2048
```
